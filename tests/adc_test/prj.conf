## CMakeLists.txt
```
cmake_minimum_required(VERSION 3.20.0)
list(APPEND BOARD_ROOT ${CMAKE_CURRENT_SOURCE_DIR}/../)
find_package(Zephyr REQUIRED HINTS $ENV{ZEPHYR_BASE})

project(adc_test)

target_sources(app PRIVATE src/main.c src/gppi.c src/saadc.c src/timer.c)
```

## prj.conf
```kconfig
CONFIG_GPIO=y
CONFIG_NRFX_SAADC=y
CONFIG_NRFX_GPPI=y # this allows peripherals to interact without cpu intervention 
CONFIG_NRFX_TIMER=y

CONFIG_LOG=y
CONFIG_LOG_BACKEND_RTT=y
CONFIG_USE_SEGGER_RTT=y
CONFIG_LOG_MODE_IMMEDIATE=y
CONFIG_RTT_CONSOLE=y
CONFIG_CONSOLE=y
CONFIG_PRINTK=y
```

## adc_test.overlay
```dts
#include <zephyr/dt-bindings/adc/adc.h>
#include <zephyr/dt-bindings/adc/nrf-adc.h>

/ {

    zephyr,user {
        io-channels = <&adc 0>;//, <&adc 1>;
    };

};

&adc {
    #address-cells = <1>;
    #size-cells = <0>;

    channel@0 {
        reg = <0>;
        zephyr,gain = "ADC_GAIN_1";
        zephyr,reference = "ADC_REF_INTERNAL";
        zephyr,acquisition-time = <ADC_ACQ_TIME_DEFAULT>;
        zephyr,input-positive = <NRF_SAADC_AIN6>;
        zephyr,resolution = <12>;
    };

    // channel@1 {
    //     reg = <1>;
    //     zephyr,gain = "ADC_GAIN_1";
    //     zephyr,reference = "ADC_REF_INTERNAL";
    //     zephyr,acquisition-time = <ADC_ACQ_TIME_DEFAULT>;
    //     zephyr,input-positive = <NRF_SAADC_AIN5>;
    //     zephyr,resolution = <12>;
    // };

};
```

## src/main.c
```c
#include <zephyr/kernel.h>

#include "peripherals.h"

int main(void) {
    configure_timer();
    configure_saadc();
    configure_ppi();
    k_sleep(K_FOREVER);
}
```

## src/gppi.c
```c
#include <helpers/nrfx_gppi.h>
#include <nrfx_saadc.h>
#include <nrfx_timer.h>
#include <zephyr/kernel.h>
#include <zephyr/logging/log.h>

#include "peripherals.h"

LOG_MODULE_DECLARE(adc_logger, LOG_LEVEL_DBG);

void configure_ppi(void) {
    int err;

    nrfx_gppi_handle_t gppi_handle_sample;
    nrfx_gppi_handle_t gppi_handle_start;

    err = nrfx_gppi_conn_alloc(
        nrfx_timer_compare_event_address_get(&timer_instance,
                                             NRF_TIMER_CC_CHANNEL0),
        nrf_saadc_task_address_get(NRF_SAADC, NRF_SAADC_TASK_SAMPLE),
        &gppi_handle_sample);
    if (err != 0) {
        LOG_ERR("nrfx_gppi_conn_alloc error: %08x", err);
        return;
    }

    err = nrfx_gppi_conn_alloc(
        nrf_saadc_event_address_get(NRF_SAADC, NRF_SAADC_EVENT_END),
        nrf_saadc_task_address_get(NRF_SAADC, NRF_SAADC_TASK_START),
        &gppi_handle_start);
    if (err != 0) {
        LOG_ERR("nrfx_gppi_conn_alloc error: %08x", err);
        return;
    }

    nrfx_gppi_conn_enable(gppi_handle_sample);
    nrfx_gppi_conn_enable(gppi_handle_start);
}
```

## src/peripherals.h
```c
#ifndef PERIPHERALS_H
#define PERIPHERALS_H

#include <nrfx_timer.h>

#define SAADC_SAMPLE_INTERVAL_US 80
#define SAADC_BUFFER_SIZE 16

#define SAADC_INPUT_PIN_0 NRFX_ANALOG_EXTERNAL_AIN4
#define SAADC_INPUT_PIN_1 NRFX_ANALOG_EXTERNAL_AIN5

#define SAADC_TIMER_INST_IDX 20

extern nrfx_timer_t timer_instance;

void configure_timer(void);
void configure_saadc(void);
void configure_ppi(void);

#endif
```

## src/saadc.c
```c
#include <nrfx_saadc.h>
#include <zephyr/kernel.h>
#include <zephyr/logging/log.h>

#include "peripherals.h"

LOG_MODULE_DECLARE(adc_logger, LOG_LEVEL_DBG);

static nrfx_saadc_channel_t channel =
    NRFX_SAADC_DEFAULT_CHANNEL_SE(NRFX_ANALOG_EXTERNAL_AIN5, 0);

static int16_t saadc_sample_buffer[2][SAADC_BUFFER_SIZE];

static uint32_t saadc_current_buffer = 0;

static void saadc_event_handler(nrfx_saadc_evt_t const* p_event) {
    int err;
    switch (p_event->type) {
        case NRFX_SAADC_EVT_READY:
            nrfx_timer_enable(&timer_instance);
            break;

        case NRFX_SAADC_EVT_BUF_REQ:
            err = nrfx_saadc_buffer_set(
                saadc_sample_buffer[(saadc_current_buffer++) % 2],
                SAADC_BUFFER_SIZE);
            if (err != 0) {
                LOG_ERR("nrfx_saadc_buffer_set error: %08x", err);
                return;
            }
            break;

        case NRFX_SAADC_EVT_DONE:
            int16_t current_value;
            for (int i = 0; i < p_event->data.done.size; i++) {
                current_value = ((int16_t*)(p_event->data.done.p_buffer))[i];
                LOG_INF("SAADC %d", current_value);
            }

            break;
        default:
            LOG_INF("Unhandled SAADC evt %d", p_event->type);
            break;
    }
}

void configure_saadc(void) {
    int err;

    IRQ_CONNECT(DT_IRQN(DT_NODELABEL(adc)), DT_IRQ(DT_NODELABEL(adc), priority),
                nrfx_isr, nrfx_saadc_irq_handler, 0);

    err = nrfx_saadc_init(DT_IRQ(DT_NODELABEL(adc), priority));
    if (err != 0) {
        LOG_ERR("nrfx_saadc_init error: %08x", err);
        return;
    }

    channel.channel_config.gain = NRF_SAADC_GAIN1_4;
    channel.channel_config.acq_time = NRF_SAADC_ACQTIME_MAX;

    err = nrfx_saadc_channels_config(&channel, 1);
    if (err != 0) {
        LOG_ERR("nrfx_saadc_channels_config error: %08x", err);
        return;
    }

    nrfx_saadc_adv_config_t saadc_adv_config = NRFX_SAADC_DEFAULT_ADV_CONFIG;
    err = nrfx_saadc_advanced_mode_set(BIT(0), NRF_SAADC_RESOLUTION_12BIT,
                                       &saadc_adv_config, saadc_event_handler);
    if (err != 0) {
        LOG_ERR("nrfx_saadc_advanced_mode_set error: %08x", err);
        return;
    }

    err = nrfx_saadc_buffer_set(saadc_sample_buffer[0], SAADC_BUFFER_SIZE);
    if (err != 0) {
        LOG_ERR("nrfx_saadc_buffer_set error: %08x", err);
        return;
    }
    err = nrfx_saadc_buffer_set(saadc_sample_buffer[1], SAADC_BUFFER_SIZE);
    if (err != 0) {
        LOG_ERR("nrfx_saadc_buffer_set error: %08x", err);
        return;
    }

    err = nrfx_saadc_mode_trigger();
    if (err != 0) {
        LOG_ERR("nrfx_saadc_mode_trigger error: %08x", err);
        return;
    }
}
```

## src/timer.c
```c
#include <nrfx_saadc.h>
#include <nrfx_timer.h>
#include <zephyr/kernel.h>
#include <zephyr/logging/log.h>

#include "peripherals.h"

LOG_MODULE_DECLARE(adc_logger, LOG_LEVEL_DBG);

nrfx_timer_t timer_instance =
    NRFX_TIMER_INSTANCE(NRF_TIMER_INST_GET(SAADC_TIMER_INST_IDX));

void configure_timer(void) {
    int err;

    uint32_t base_frequency =
        NRF_TIMER_BASE_FREQUENCY_GET(timer_instance.p_reg);
    nrfx_timer_config_t timer_config =
        NRFX_TIMER_DEFAULT_CONFIG(base_frequency);

    err = nrfx_timer_init(&timer_instance, &timer_config, NULL);
    if (err != 0) {
        LOG_ERR("nrfx_timer_init error: %08x", err);
        return;
    }
    uint32_t timer_ticks =
        nrfx_timer_us_to_ticks(&timer_instance, SAADC_SAMPLE_INTERVAL_US);
    nrfx_timer_extended_compare(&timer_instance, NRF_TIMER_CC_CHANNEL0,
                                timer_ticks,
                                NRF_TIMER_SHORT_COMPARE0_CLEAR_MASK, false);
}
```
