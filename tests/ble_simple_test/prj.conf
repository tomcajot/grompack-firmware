## CMakeLists.txt
```
cmake_minimum_required(VERSION 3.20.0)
list(APPEND BOARD_ROOT ${CMAKE_CURRENT_SOURCE_DIR}/../)
find_package(Zephyr REQUIRED HINTS $ENV{ZEPHYR_BASE})
project(grompack_ble_simple_test)

target_sources(app PRIVATE
    src/main.c
    src/ble.c
)
```

## prj.conf
```kconfig
CONFIG_LOG=y
CONFIG_USE_SEGGER_RTT=y
CONFIG_LOG_BACKEND_RTT=y
CONFIG_LOG_BACKEND_UART=n
CONFIG_LOG_MODE_IMMEDIATE=y
CONFIG_RTT_CONSOLE=y
CONFIG_CONSOLE=y
CONFIG_PRINTK=y

CONFIG_BT=y
CONFIG_BT_PERIPHERAL=y
CONFIG_BT_DEVICE_NAME="grompack"
CONFIG_BT_NUS=y


CONFIG_BT_L2CAP_TX_MTU=247
CONFIG_BT_BUF_ACL_TX_SIZE=251
CONFIG_BT_BUF_ACL_RX_SIZE=251
CONFIG_BT_CTLR_DATA_LENGTH_MAX=251

CONFIG_BT_ZEPHYR_NUS=y
CONFIG_BT_USER_PHY_UPDATE=y
CONFIG_BT_USER_DATA_LEN_UPDATE=y
CONFIG_BT_ATT_TX_COUNT=4
CONFIG_BT_CONN_TX_MAX=3
CONFIG_HEAP_MEM_POOL_SIZE=4096
CONFIG_BT_PERIPHERAL_PREF_MIN_INT=11
CONFIG_BT_PERIPHERAL_PREF_MAX_INT=14
CONFIG_BT_CTLR_PHY_2M=y
CONFIG_BT_PERIPHERAL_PREF_LATENCY=0
CONFIG_BT_PERIPHERAL_PREF_TIMEOUT=400
```

## src/main.c
```c
#include <zephyr/bluetooth/services/nus.h>
#include <zephyr/kernel.h>
#include <zephyr/logging/log.h>

#include "peripherals.h"

LOG_MODULE_REGISTER(ble_simple_logger, LOG_LEVEL_DBG);

K_MSGQ_DEFINE(ble_data_queue, sizeof(struct neural_packet), 10, 4);

static struct neural_packet fake_packet;
static uint32_t fake_index = 0;

static void fake_data_handler(struct k_timer* dummy) {
    ARG_UNUSED(dummy);
    fake_packet.sample_index = fake_index++;
    for (int i = 0; i < PACKED_BUFFER_SIZE; i++) {
        fake_packet.packed_data[i] = (uint8_t)(i + fake_index);
    }
    k_msgq_put(&ble_data_queue, &fake_packet, K_NO_WAIT);
}
K_TIMER_DEFINE(fake_timer, fake_data_handler, NULL);

int main(void) {
    configure_ble();
    LOG_INF("BLE test running — waiting for subscription\n");

    struct neural_packet tx_packet;
    int err;

    while (1) {
        if (k_msgq_get(&ble_data_queue, &tx_packet, K_FOREVER) == 0) {
            if (is_laptop_subscribed) {
                err =
                    bt_nus_send(NULL, (uint8_t*)&tx_packet, sizeof(tx_packet));
                if (err && err != -EAGAIN && err != -ENOTCONN) {
                    LOG_ERR("Transmission error: %d\n", err);
                }
            }
        }
    }
}
```

## src/ble.c
```c
#include <zephyr/bluetooth/bluetooth.h>
#include <zephyr/bluetooth/services/nus.h>
#include <zephyr/kernel.h>
#include <zephyr/logging/log.h>

#include "peripherals.h"

LOG_MODULE_DECLARE(ble_simple_logger, LOG_LEVEL_DBG);

#define DEVICE_NAME CONFIG_BT_DEVICE_NAME
#define DEVICE_NAME_LEN (sizeof(DEVICE_NAME) - 1)

bool is_laptop_subscribed = false;

static const struct bt_data ad[] = {
    BT_DATA_BYTES(BT_DATA_FLAGS, (BT_LE_AD_GENERAL | BT_LE_AD_NO_BREDR)),
    BT_DATA(BT_DATA_NAME_COMPLETE, DEVICE_NAME, DEVICE_NAME_LEN),
};

static const struct bt_data sd[] = {
    BT_DATA_BYTES(BT_DATA_UUID128_ALL, BT_UUID_NUS_SRV_VAL),
};

static void notif_enabled(bool enabled, void* ctx) {
    ARG_UNUSED(ctx);
    LOG_INF("Laptop Subscription: %s\n", (enabled ? "Enabled" : "Disabled"));
    is_laptop_subscribed = enabled;

    if (enabled) {
        k_msgq_purge(&ble_data_queue);
        k_timer_start(&fake_timer, K_MSEC(8), K_MSEC(8));
    } else {
        k_timer_stop(&fake_timer);
        k_msgq_purge(&ble_data_queue);
    }
}

static void received(struct bt_conn* conn, const void* data, uint16_t len,
                     void* ctx) {
    ARG_UNUSED(conn);
    ARG_UNUSED(ctx);
    LOG_INF("Command Received from Laptop: %.*s\n", len, (char*)data);
}

struct bt_nus_cb nus_listener = {
    .notif_enabled = notif_enabled,
    .received = received,
};

static void on_connected(struct bt_conn* conn, uint8_t err) {
    if (err) {
        LOG_ERR("Connection failed, err 0x%02x\n", err);
        return;
    }
    LOG_INF("Connected!\n");

    bt_conn_le_data_len_update(conn, BT_LE_DATA_LEN_PARAM_MAX);
    bt_conn_le_phy_update(conn, BT_CONN_LE_PHY_PARAM_2M);
}

static void on_disconnected(struct bt_conn* conn, uint8_t reason) {
    ARG_UNUSED(conn);
    LOG_INF("Disconnected, reason 0x%02x\n", reason);

    is_laptop_subscribed = false;
    k_timer_stop(&fake_timer);
    k_msgq_purge(&ble_data_queue);

    int err = bt_le_adv_start(BT_LE_ADV_CONN_FAST_1, ad, ARRAY_SIZE(ad), sd,
                              ARRAY_SIZE(sd));
    if (err) {
        LOG_ERR("Failed to restart advertising (err %d)\n", err);
    }
}

BT_CONN_CB_DEFINE(conn_callbacks) = {
    .connected = on_connected,
    .disconnected = on_disconnected,
};

void configure_ble(void) {
    int err;

    err = bt_enable(NULL);
    if (err) {
        LOG_ERR("BLE init failed (err %d)\n", err);
        return;
    }

    err = bt_nus_cb_register(&nus_listener, NULL);
    if (err) {
        LOG_ERR("NUS callbacks failed to register (err %d)\n", err);
        return;
    }

    err = bt_le_adv_start(BT_LE_ADV_CONN_FAST_1, ad, ARRAY_SIZE(ad), sd,
                          ARRAY_SIZE(sd));
    if (err) {
        LOG_ERR("Advertising failed to start (err %d)\n", err);
        return;
    }

    LOG_INF("Advertising as '%s'. Ready for connection.\n", DEVICE_NAME);
}
```

## src/peripherals.h
```c
#ifndef PERIPHERALS_H
#define PERIPHERALS_H

#include <stdbool.h>
#include <zephyr/bluetooth/services/nus.h>
#include <zephyr/kernel.h>

#define PACKED_BUFFER_SIZE 240

struct neural_packet {
    uint32_t sample_index;
    uint8_t packed_data[PACKED_BUFFER_SIZE];
} __packed;

extern struct k_msgq ble_data_queue;
extern struct k_timer fake_timer;
extern bool is_laptop_subscribed;

void configure_ble(void);

#endif
```
