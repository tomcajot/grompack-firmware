## app/build/Kconfig/boards/Kconfig
```kconfig
# Load Zephyr board Kconfig descriptions.
osource "/Users/tomcajot/Desktop/bap/grompack-firmware/boards/Team_Kakkerlak/gromboard-minewsemi/Kconfig"
```

## app/build/Kconfig/boards/Kconfig.defconfig
```kconfig
# Load Zephyr board defconfig descriptions.
osource "/Users/tomcajot/Desktop/bap/grompack-firmware/boards/Team_Kakkerlak/gromboard-minewsemi/Kconfig.defconfig"
```

## app/build/app/Kconfig/Kconfig.shield
```kconfig
osource "/Users/tomcajot/Desktop/bap/grompack-firmware/boards/shields/*/Kconfig.shield"
osource "/Users/tomcajot/Desktop/bap/grompack-firmware/app/..//boards/shields/*/Kconfig.shield"
osource "/opt/nordic/ncs/v3.3.0/nrf/boards/shields/*/Kconfig.shield"
```

## app/build/app/Kconfig/boards/Kconfig.gromboard-minewsemi.tmp
```kconfig
# Load board Kconfig descriptions.
osource "/Users/tomcajot/Desktop/bap/grompack-firmware/boards/Team_Kakkerlak/gromboard-minewsemi/Kconfig.gromboard-minewsemi"
```

## boards/Team_Kakkerlak/gromboard-minewsemi/Kconfig.gromboard-minewsemi
```kconfig
config BOARD_GROMBOARD_MINEWSEMI
    bool "Gromboard Minewsemi"
    select SOC_NRF54L15_CPUAPP
```

## boards/Team_Kakkerlak/gromboard-minewsemi/board.yml
```yaml
board:
  name: gromboard-minewsemi
  full_name: gromboard-minewsemi
  vendor: Team_Kakkerlak
  socs:
    - name: nrf54l15

runners:
  run_once:
    "--recover":
      - runners:
          - nrfjprog
          - nrfutil
        run: first
        groups:
          - boards:
              - gromboard-minewsemi/nrf54l15/cpuapp
    "--erase":
      - runners:
          - nrfjprog
          - jlink
          - nrfutil
        run: first
        groups:
          - boards:
              - gromboard-minewsemi/nrf54l15/cpuapp
    "--reset":
      - runners:
          - nrfjprog
          - jlink
          - nrfutil
        run: last
        groups:
          - boards:
              - gromboard-minewsemi/nrf54l15/cpuapp
```

## boards/Team_Kakkerlak/gromboard-minewsemi/gromboard-minewsemi_nrf54l15_cpuapp_defconfig
```kconfig
## Default Configs ##
CONFIG_ARM_MPU=y
CONFIG_NULL_POINTER_EXCEPTION_DETECTION_NONE=y
CONFIG_CACHE_MANAGEMENT=y
CONFIG_EXTERNAL_CACHE=y
CONFIG_NRF_GRTC_START_SYSCOUNTER=y
CONFIG_CLOCK_CONTROL_NRF_K32SRC_XTAL=y
```

## tests/adc_test/build/adc_test/Kconfig/Kconfig.shield
```kconfig
osource "/Users/tomcajot/Desktop/bap/grompack-firmware/tests/adc_test/..//boards/shields/*/Kconfig.shield"
osource "/opt/nordic/ncs/v3.3.0/nrf/boards/shields/*/Kconfig.shield"
```

## tests/adc_test/build/adc_test/Kconfig/Kconfig.shield.defconfig
```kconfig
osource "/Users/tomcajot/Desktop/bap/grompack-firmware/boards/shields/*/Kconfig.defconfig"
osource "/Users/tomcajot/Desktop/bap/grompack-firmware/tests/adc_test/..//boards/shields/*/Kconfig.defconfig"
osource "/opt/nordic/ncs/v3.3.0/nrf/boards/shields/*/Kconfig.defconfig"
```

## tests/ble_simple_test/build/ble_simple_test/Kconfig/Kconfig.shield.defconfig
```kconfig
osource "/Users/tomcajot/Desktop/bap/grompack-firmware/boards/shields/*/Kconfig.defconfig"
osource "/Users/tomcajot/Desktop/bap/grompack-firmware/tests/ble_simple_test/..//boards/shields/*/Kconfig.defconfig"
osource "/opt/nordic/ncs/v3.3.0/nrf/boards/shields/*/Kconfig.defconfig"
```

## tests/gpio_test/build/gpio_test/Kconfig/Kconfig.shield
```kconfig
osource "/Users/tomcajot/Desktop/bap/grompack-firmware/boards/shields/*/Kconfig.shield"
osource "/Users/tomcajot/Desktop/bap/grompack-firmware/tests/gpio_test/..//boards/shields/*/Kconfig.shield"
osource "/opt/nordic/ncs/v3.3.0/nrf/boards/shields/*/Kconfig.shield"
```
